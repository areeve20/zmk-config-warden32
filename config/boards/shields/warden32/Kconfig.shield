## config/boards/shields/warden32/Kconfig.shield
```kconfig
# Copyright (c) 2023 The ZMK Contributors
# SPDX-License-Identifier: MIT

config SHIELD_WARDEN32
    def_bool $(shields_list_contains,warden32)
```

## config/shields/warden32/Kconfig.defconfig
```kconfig
# Copyright (c) 2023 The ZMK Contributors
# SPDX-License-Identifier: MIT

if SHIELD_ROLLTOP

config ZMK_KEYBOARD_NAME
    default "warden32"

endif
```
